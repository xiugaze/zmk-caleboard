## boards/shields/caleboard/Kconfig.defconfig
```kconfig
# if SHIELD_CALEBOARD_LEFT
#   config ZMK_KEYBOARD_NAME
#     default "caleboard v0.1"
#   config ZMK_SPLIT_ROLE_CENTRAL
#     default y
# endif
#

if SHIELD_CALEBOARD_DONGLE

config ZMK_KEYBOARD_NAME
    default "caleboard v0.1"

config ZMK_SPLIT_ROLE_CENTRAL
    default y

config ZMK_SPLIT
    default y

config ZMK_SPLIT_BLE_CENTRAL_PERIPHERALS
    default 2

config BT_MAX_CONN
    default 6

config BT_MAX_PAIRED
    default 6

endif

if SHIELD_CALEBOARD_LEFT || SHIELD_CALEBOARD_RIGHT
  config ZMK_SPLIT
    default y
endif
```

## boards/shields/caleboard/Kconfig.shield
```kconfig
config SHIELD_CALEBOARD_LEFT
  def_bool $(shields_list_contains, caleboard_left)

config SHIELD_CALEBOARD_RIGHT
  def_bool $(shields_list_contains, caleboard_right)
```
